/*
 * Copyright (c) 2021 Nordic Semiconductor ASA
 * SPDX-License-Identifier: Apache-2.0
 */

/dts-v1/;
#include "promicro.dtsi"

/ {
	chosen {
		zmk,battery = &vbatt;
	};

	// Node name must match original "EXT_POWER" label to preserve user settings.
	EXT_POWER {
		compatible = "zmk,ext-power-generic";
		control-gpios = <&gpio0 13 GPIO_ACTIVE_HIGH>;
		init-delay-ms = <50>;
	};

	vbatt: vbatt {
		compatible = "zmk,battery-nrf-vddh";
	};
};
