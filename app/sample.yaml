## app/sample.yaml
```yaml
# This file is provided so that the application can be compiled using Twister,
# the Zephyr testing tool. In this file, multiple combinations can be specified,
# so that you can easily test all of them locally or in CI.
sample:
  description: Promicro CN example
  name: promicro_cn
common:
  build_only: true
  integration_platforms:
    - promicro
tests:
  app.default: {}
  app.debug:
    extra_overlay_confs:
      - debug.conf
```

## boards/arm/promicro/Kconfig
```kconfig
# Copyright (c) 2021 Nordic Semiconductor ASA
# SPDX-License-Identifier: Apache-2.0

config BOARD_ENABLE_DCDC
	bool "Enable DCDC mode"
	select SOC_DCDC_NRF52X
	default y
	depends on BOARD_PROMICRO

config BOARD_ENABLE_DCDC_HV
    bool "High voltage DCDC converter"
    select SOC_DCDC_NRF52X_HV
    default y
    depends on BOARD_PROMICRO
```

## boards/arm/promicro/Kconfig.board
```kconfig
# Copyright (c) 2021 Nordic Semiconductor ASA
# SPDX-License-Identifier: Apache-2.0

config BOARD_PROMICRO
    bool "promicro"
	depends on SOC_NRF52840_QIAA
```

## boards/arm/promicro/Kconfig.defconfig
```kconfig
# Copyright (c) 2021 The ZMK Contributors
# SPDX-License-Identifier: MIT

if BOARD_PROMICRO

config BOARD
    default "promicro"

if USB_DEVICE_STACK

config USB_NRFX
    default y

endif # USB_DEVICE_STACK

config BT_CTLR
    default BT

endif # BOARD_PROMICRO
```

## boards/shields/stellar/Kconfig.defconfig
```kconfig
if SHIELD_STELLAR_LEFT

    config ZMK_KEYBOARD_NAME
        default "Stellar"

    config ZMK_SPLIT_BLE_ROLE_CENTRAL
        default y

endif # LEFT



if SHIELD_STELLAR_LEFT || SHIELD_STELLAR_RIGHT

    config ZMK_SPLIT
        default y

endif # LEFT RIGHT
```

## boards/shields/stellar/Kconfig.shield
```kconfig
config SHIELD_KLOR_LEFT
    def_bool $(shields_list_contains,stellar_left)

config SHIELD_KLOR_RIGHT
    def_bool $(shields_list_contains,strllar_right)
```
